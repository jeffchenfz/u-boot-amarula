## drivers/reset/sunxi/Kconfig
```kconfig
config RESET_SUNXI
	bool "RESET support for Allwinner SoCs"
	depends on ARCH_SUNXI
	depends on CLK_SUNXI
	select DM_RESET
	help
	  This enables support for common reset driver API on Allwinner
	  SoCs.

if RESET_SUNXI

config RESET_SUN4I_A10
	bool "Reset driver for Allwinner A10/A20"
	default MACH_SUN4I || MACH_SUN7I
	help
	  This enables common reset driver support for platforms based
	  on Allwinner A10/A20 SoC.

config RESET_SUN5I_A10S
	bool "Reset driver for Allwinner A10s/A13"
	default MACH_SUN5I
	help
	  This enables common reset driver support for platforms based
	  on Allwinner A10s/A13 SoC.

config RESET_SUN6I_A31
	bool "Reset driver for Allwinner A31/A31s"
	default MACH_SUN6I
	help
	  This enables common reset driver support for platforms based
	  on Allwinner A31/A31s SoC.

config RESET_SUN8I_A23
	bool "Reset driver for Allwinner A23"
	default MACH_SUN8I_A23
	help
	  This enables common reset driver support for platforms based
	  on Allwinner A23 SoC.

config RESET_SUN8I_H3
	bool "Reset driver for Allwinner H3/H5"
	default MACH_SUNXI_H3_H5
	help
	  This enables common reset driver support for platforms based
	  on Allwinner H3/H5 SoC.

config RESET_SUN50I_A64
	bool "Reset driver for Allwinner A64"
	default MACH_SUN50I
	help
	  This enables common reset driver support for platforms based
	  on Allwinner A64 SoC.

endif # RESET_SUNXI
```
